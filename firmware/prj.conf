## CMakeLists.txt
```
cmake_minimum_required(VERSION 3.20.0)
find_package(Zephyr REQUIRED HINTS $ENV{ZEPHYR_BASE})
project(superteem_pin)
target_sources(app PRIVATE src/main.c src/adpcm.c)
```

## west.yml
```
# The Zephyr workspace for the pin firmware: `west init -l firmware && west update` from the repository root.
# Only the modules the XIAO nRF52840 Sense needs are fetched.
manifest:
  remotes:
    - name: zephyrproject-rtos
      url-base: https://github.com/zephyrproject-rtos
  projects:
    - name: zephyr
      remote: zephyrproject-rtos
      revision: v4.2.0
      import:
        name-allowlist:
          - cmsis
          - cmsis_6
          - hal_nordic
          # Bluetooth pairing does its cryptography through PSA, which mbedtls provides.
          - mbedtls
  self:
    path: firmware
```

## prj.conf
```kconfig
CONFIG_AUDIO=y
CONFIG_AUDIO_DMIC=y
CONFIG_GPIO=y
CONFIG_LOG=y
CONFIG_ENTROPY_GENERATOR=y

CONFIG_BT=y
CONFIG_BT_PERIPHERAL=y
CONFIG_BT_DEVICE_NAME="Superteem Pin"
CONFIG_BT_SMP=y
CONFIG_BT_L2CAP_DYNAMIC_CHANNEL=y
CONFIG_BT_USER_PHY_UPDATE=y
CONFIG_BT_USER_DATA_LEN_UPDATE=y
CONFIG_BT_L2CAP_TX_MTU=247
CONFIG_BT_BUF_ACL_TX_SIZE=251
CONFIG_BT_BUF_ACL_RX_SIZE=251
CONFIG_BT_CTLR_DATA_LENGTH_MAX=251

CONFIG_BT_SETTINGS=y
CONFIG_SETTINGS=y
CONFIG_NVS=y
CONFIG_FLASH=y
CONFIG_FLASH_MAP=y
```

## app.overlay
```dts
&pdm0 {
	status = "okay";
};
```

## src/main.c
```c
/* Step 0 radio test firmware for the XIAO nRF52840 Sense.
 *
 * Streams ADPCM frames over an L2CAP channel (PSM 0x0080), or GATT notifications as a fallback,
 * only while a bonded phone is subscribed. The green LED is on while streaming audio. Capture to
 * flash is not implemented yet, so the red "recording locally" state does not exist here.
 */

#include <string.h>
#include <zephyr/audio/dmic.h>
#include <zephyr/bluetooth/bluetooth.h>
#include <zephyr/bluetooth/conn.h>
#include <zephyr/bluetooth/gatt.h>
#include <zephyr/bluetooth/l2cap.h>
#include <zephyr/bluetooth/uuid.h>
#include <zephyr/drivers/gpio.h>
#include <zephyr/kernel.h>
#include <zephyr/logging/log.h>
#include <zephyr/net_buf.h>
#include <zephyr/random/random.h>
#include <zephyr/settings/settings.h>
#include <zephyr/sys/byteorder.h>

#include "adpcm.h"

LOG_MODULE_REGISTER(stv_pin, LOG_LEVEL_INF);

#define SAMPLES_PER_FRAME 320
#define BLOCK_BYTES       (SAMPLES_PER_FRAME * 2)
#define BLOCK_COUNT       8
#define HEADER_LEN        15
#define CODEC_IMA_ADPCM   2
#define PAYLOAD_LEN       (STV_ADPCM_STATE_LEN + SAMPLES_PER_FRAME / 2)
#define FRAME_LEN         (HEADER_LEN + PAYLOAD_LEN)
#define AUDIO_PSM         0x0080

K_MEM_SLAB_DEFINE_STATIC(pcm_slab, BLOCK_BYTES, BLOCK_COUNT, 4);
NET_BUF_POOL_FIXED_DEFINE(tx_pool, 8, BT_L2CAP_SDU_BUF_SIZE(FRAME_LEN), CONFIG_BT_CONN_TX_USER_DATA_SIZE,
			  NULL);

static const struct device *const dmic = DEVICE_DT_GET(DT_NODELABEL(pdm0));
static const struct gpio_dt_spec green_led = GPIO_DT_SPEC_GET(DT_ALIAS(led1), gpios);

static struct bt_conn *active_conn;
static bool l2cap_open;
static bool gatt_subscribed;
static K_SEM_DEFINE(stream_wanted, 0, 1);

#define STV_SERVICE_UUID BT_UUID_128_ENCODE(0x5354564f, 0x1000, 0x4e00, 0x8000, 0x535456000001)
#define STV_AUDIO_UUID   BT_UUID_128_ENCODE(0x5354564f, 0x1001, 0x4e00, 0x8000, 0x535456000001)

static void audio_ccc_changed(const struct bt_gatt_attr *attr, uint16_t value);

BT_GATT_SERVICE_DEFINE(stv_service, BT_GATT_PRIMARY_SERVICE(BT_UUID_DECLARE_128(STV_SERVICE_UUID)),
		       BT_GATT_CHARACTERISTIC(BT_UUID_DECLARE_128(STV_AUDIO_UUID), BT_GATT_CHRC_NOTIFY,
					      BT_GATT_PERM_NONE, NULL, NULL, NULL),
		       BT_GATT_CCC(audio_ccc_changed, BT_GATT_PERM_READ | BT_GATT_PERM_WRITE_ENCRYPT));

static bool streaming_wanted(void)
{
	return active_conn != NULL && (l2cap_open || gatt_subscribed);
}

static void update_stream_state(void)
{
	if (streaming_wanted()) {
		k_sem_give(&stream_wanted);
	}
}

static void audio_ccc_changed(const struct bt_gatt_attr *attr, uint16_t value)
{
	ARG_UNUSED(attr);
	gatt_subscribed = value == BT_GATT_CCC_NOTIFY;
	update_stream_state();
}

static int l2cap_recv(struct bt_l2cap_chan *chan, struct net_buf *buf)
{
	ARG_UNUSED(chan);
	ARG_UNUSED(buf);
	return 0;
}

static void l2cap_connected(struct bt_l2cap_chan *chan)
{
	ARG_UNUSED(chan);
	l2cap_open = true;
	update_stream_state();
}

static void l2cap_disconnected(struct bt_l2cap_chan *chan)
{
	ARG_UNUSED(chan);
	l2cap_open = false;
}

static const struct bt_l2cap_chan_ops l2cap_ops = {
	.recv = l2cap_recv,
	.connected = l2cap_connected,
	.disconnected = l2cap_disconnected,
};

static struct bt_l2cap_le_chan audio_chan = {
	.chan.ops = &l2cap_ops,
	.rx.mtu = 64,
};

static int l2cap_accept(struct bt_conn *conn, struct bt_l2cap_server *server, struct bt_l2cap_chan **chan)
{
	ARG_UNUSED(conn);
	ARG_UNUSED(server);
	if (l2cap_open) {
		return -ENOMEM;
	}
	*chan = &audio_chan.chan;
	return 0;
}

static struct bt_l2cap_server l2cap_server = {
	.psm = AUDIO_PSM,
	.sec_level = BT_SECURITY_L2,
	.accept = l2cap_accept,
};

static void start_advertising(struct k_work *work)
{
	const struct bt_data ad[] = {
		BT_DATA_BYTES(BT_DATA_FLAGS, BT_LE_AD_GENERAL | BT_LE_AD_NO_BREDR),
		BT_DATA_BYTES(BT_DATA_UUID128_ALL, STV_SERVICE_UUID),
	};
	const struct bt_data sd[] = {
		BT_DATA(BT_DATA_NAME_COMPLETE, CONFIG_BT_DEVICE_NAME, sizeof(CONFIG_BT_DEVICE_NAME) - 1),
	};
	int err = bt_le_adv_start(BT_LE_ADV_CONN_FAST_2, ad, ARRAY_SIZE(ad), sd, ARRAY_SIZE(sd));

	ARG_UNUSED(work);
	if (err != 0 && err != -EALREADY) {
		LOG_ERR("advertising failed: %d", err);
	}
}

static K_WORK_DEFINE(adv_work, start_advertising);

static void on_connected(struct bt_conn *conn, uint8_t err)
{
	static const struct bt_conn_le_phy_param phy = {
		.options = BT_CONN_LE_PHY_OPT_NONE,
		.pref_tx_phy = BT_GAP_LE_PHY_2M,
		.pref_rx_phy = BT_GAP_LE_PHY_2M,
	};

	if (err != 0) {
		return;
	}
	active_conn = bt_conn_ref(conn);
	/* The phone may refuse these. Its choice is logged on the app side. */
	bt_conn_le_param_update(conn, BT_LE_CONN_PARAM(24, 36, 0, 400));
	bt_conn_le_phy_update(conn, &phy);
}

static void on_disconnected(struct bt_conn *conn, uint8_t reason)
{
	ARG_UNUSED(conn);
	LOG_INF("disconnected: %u", reason);
	bt_conn_unref(active_conn);
	active_conn = NULL;
	gatt_subscribed = false;
}

static void on_recycled(void)
{
	k_work_submit(&adv_work);
}

BT_CONN_CB_DEFINE(conn_callbacks) = {
	.connected = on_connected,
	.disconnected = on_disconnected,
	.recycled = on_recycled,
};

static void write_header(uint8_t *out, uint16_t session, uint32_t sequence, uint32_t sample_counter)
{
	out[0] = 0;
	out[1] = 0;
	sys_put_le16(session, &out[2]);
	sys_put_le32(sequence, &out[4]);
	sys_put_le32(sample_counter, &out[8]);
	out[12] = CODEC_IMA_ADPCM;
	sys_put_le16(PAYLOAD_LEN, &out[13]);
}

/* A frame that cannot be queued is dropped. The sequence gap makes the loss visible to the app. */
static void send_frame(const uint8_t *frame)
{
	if (l2cap_open) {
		struct net_buf *buf = net_buf_alloc(&tx_pool, K_NO_WAIT);

		if (buf == NULL) {
			return;
		}
		net_buf_reserve(buf, BT_L2CAP_SDU_CHAN_SEND_RESERVE);
		net_buf_add_mem(buf, frame, FRAME_LEN);
		if (bt_l2cap_chan_send(&audio_chan.chan, buf) < 0) {
			net_buf_unref(buf);
		}
	} else if (gatt_subscribed && active_conn != NULL) {
		bt_gatt_notify(active_conn, &stv_service.attrs[1], frame, FRAME_LEN);
	}
}

static void stream_until_stopped(void)
{
	static uint8_t frame[FRAME_LEN];
	uint16_t session = (uint16_t)sys_rand32_get();
	uint32_t sequence = 0;
	uint32_t sample_counter = 0;
	uint8_t index = 0;

	if (dmic_trigger(dmic, DMIC_TRIGGER_START) < 0) {
		LOG_ERR("mic start failed");
		return;
	}
	gpio_pin_set_dt(&green_led, 1);
	while (streaming_wanted()) {
		void *block;
		size_t size;

		if (dmic_read(dmic, 0, &block, &size, 1000) < 0) {
			LOG_ERR("mic read failed");
			break;
		}
		write_header(frame, session, sequence, sample_counter);
		stv_adpcm_encode(block, size / 2, &index, &frame[HEADER_LEN]);
		k_mem_slab_free(&pcm_slab, block);
		send_frame(frame);
		sequence++;
		sample_counter += SAMPLES_PER_FRAME;
	}
	gpio_pin_set_dt(&green_led, 0);
	dmic_trigger(dmic, DMIC_TRIGGER_STOP);
}

static int configure_mic(void)
{
	struct pcm_stream_cfg stream = {
		.pcm_rate = 16000,
		.pcm_width = 16,
		.block_size = BLOCK_BYTES,
		.mem_slab = &pcm_slab,
	};
	struct dmic_cfg cfg = {
		.io = {
			.min_pdm_clk_freq = 1000000,
			.max_pdm_clk_freq = 3500000,
			.min_pdm_clk_dc = 40,
			.max_pdm_clk_dc = 60,
		},
		.streams = &stream,
		.channel = {
			.req_num_streams = 1,
			.req_num_chan = 1,
			.req_chan_map_lo = dmic_build_channel_map(0, 0, PDM_CHAN_LEFT),
		},
	};

	return device_is_ready(dmic) ? dmic_configure(dmic, &cfg) : -ENODEV;
}

int main(void)
{
	int err;

	gpio_pin_configure_dt(&green_led, GPIO_OUTPUT_INACTIVE);

	err = configure_mic();
	if (err != 0) {
		LOG_ERR("mic setup failed: %d", err);
		return err;
	}
	err = bt_enable(NULL);
	if (err != 0) {
		LOG_ERR("bluetooth failed: %d", err);
		return err;
	}
	settings_load();
	err = bt_l2cap_server_register(&l2cap_server);
	if (err != 0) {
		LOG_ERR("l2cap failed: %d", err);
		return err;
	}
	k_work_submit(&adv_work);

	while (true) {
		k_sem_take(&stream_wanted, K_FOREVER);
		if (streaming_wanted()) {
			stream_until_stopped();
		}
	}
}
```

## src/adpcm.c
```c
/* SPDX-License-Identifier: MIT */
/* IMA ADPCM encoder. Must match core/src/adpcm.rs, which core/tests/adpcm_c.rs checks. */

#include "adpcm.h"

static const int8_t index_table[16] = {-1, -1, -1, -1, 2, 4, 6, 8, -1, -1, -1, -1, 2, 4, 6, 8};

static const int16_t step_table[89] = {
	7,     8,     9,     10,    11,    12,    13,    14,    16,    17,    19,    21,    23,
	25,    28,    31,    34,    37,    41,    45,    50,    55,    60,    66,    73,    80,
	88,    97,    107,   118,   130,   143,   157,   173,   190,   209,   230,   253,   279,
	307,   337,   371,   408,   449,   494,   544,   598,   658,   724,   796,   876,   963,
	1060,  1166,  1282,  1411,  1552,  1707,  1878,  2066,  2272,  2499,  2749,  3024,  3327,
	3660,  4026,  4428,  4871,  5358,  5894,  6484,  7132,  7845,  8630,  9493,  10442, 11487,
	12635, 13899, 15289, 16818, 18500, 20350, 22385, 24623, 27086, 29794, 32767,
};

size_t stv_adpcm_encode(const int16_t *pcm, size_t count, uint8_t *index, uint8_t *out)
{
	int32_t predictor = count > 0 ? pcm[0] : 0;
	int32_t idx = *index;
	size_t len = STV_ADPCM_STATE_LEN;

	out[0] = (uint8_t)(predictor & 0xFF);
	out[1] = (uint8_t)((predictor >> 8) & 0xFF);
	out[2] = *index;

	for (size_t i = 0; i < count; i++) {
		int32_t step = step_table[idx];
		int32_t delta = pcm[i] - predictor;
		int32_t diff = step >> 3;
		uint8_t nibble = 0;

		if (delta < 0) {
			nibble = 8;
			delta = -delta;
		}
		if (delta >= step) {
			nibble |= 4;
			delta -= step;
			diff += step;
		}
		if (delta >= (step >> 1)) {
			nibble |= 2;
			delta -= step >> 1;
			diff += step >> 1;
		}
		if (delta >= (step >> 2)) {
			nibble |= 1;
			diff += step >> 2;
		}

		predictor += (nibble & 8) ? -diff : diff;
		if (predictor > 32767) {
			predictor = 32767;
		} else if (predictor < -32768) {
			predictor = -32768;
		}
		idx += index_table[nibble];
		if (idx < 0) {
			idx = 0;
		} else if (idx > 88) {
			idx = 88;
		}

		if ((i & 1) == 0) {
			out[len++] = nibble;
		} else {
			out[len - 1] |= (uint8_t)(nibble << 4);
		}
	}
	*index = (uint8_t)idx;
	return len;
}
```

## src/adpcm.h
```c
/* SPDX-License-Identifier: MIT */
#ifndef STV_ADPCM_H
#define STV_ADPCM_H

#include <stddef.h>
#include <stdint.h>

#define STV_ADPCM_STATE_LEN 3

/* Encodes one frame to protocol/PROTOCOL-v0.md layout and returns the payload length.
 * `index` keeps the step size adapted between frames. `out` needs 3 + (count + 1) / 2 bytes.
 */
size_t stv_adpcm_encode(const int16_t *pcm, size_t count, uint8_t *index, uint8_t *out);

#endif
```
